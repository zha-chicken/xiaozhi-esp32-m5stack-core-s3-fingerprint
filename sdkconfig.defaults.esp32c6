## sdkconfig.defaults.esp32c6
```kconfig
CONFIG_ESPTOOLPY_FLASHSIZE_16MB=y
CONFIG_PARTITION_TABLE_CUSTOM_FILENAME="partitions/v2/16m_c3.csv"
CONFIG_ESPTOOLPY_FLASHMODE_QIO=y

CONFIG_SR_WN_WN9S_NIHAOXIAOZHI=y

# Hao Lab badge-watch UI: Latin numerics for pairing code (28pt),
# upgrade percent (36pt), and boot wordmark / error glyph (44pt).
# Chinese labels keep using puhui_basic_16 from xiaozhi-fonts.
CONFIG_LV_FONT_MONTSERRAT_28=y
CONFIG_LV_FONT_MONTSERRAT_36=y
CONFIG_LV_FONT_MONTSERRAT_44=y
# Spinner widget for boot / activating splash screens.
CONFIG_LV_USE_SPINNER=y
```
