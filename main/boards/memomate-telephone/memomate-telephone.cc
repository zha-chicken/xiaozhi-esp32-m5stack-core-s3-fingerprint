#include "wifi_board.h"
#include "codecs/es8311_audio_codec.h"
#include "application.h"
#include "button.h"
#include "config.h"
#include "memomate_base_link.h"
#include "memomate_control_link.h"
#include "memomate_led.h"
#include "power_manager.h"
#include <esp_log.h>
#include <esp_timer.h>
#include <driver/i2c_master.h>
#include <wifi_station.h>
#include <freertos/FreeRTOS.h>
#include <freertos/task.h>

#define TAG "memomate_telephone"

// MemoMate Telephone — headless board (LCD removed) for a vintage rotary
// phone shell. Interaction model is deterministic by design after the IMU
// pickup-detection experiment proved too flaky in demos:
//   PWR  long-press → power on / off (battery EN soft-latch)
//   BOOT click      → talk key: start / pause conversation (ToggleChatState)
// State feedback with no screen: the WS2812 LED carries the full 灯语 (see
// memomate_led.cc — never dark while powered). Custom voice cues were tried
// and removed: too intrusive for the user, the LED covers it.

// Ignore PWR long-press events in the first window after boot — on battery
// the MCU cold-starts because the user is physically pressing PWR, and we
// don't want a slightly-long boot tap to immediately trigger PowerOff.
static constexpr int64_t kBootLongPressGuardUs = 2'000'000;

class CustomBoard : public WifiBoard {
private:
    Button boot_button_;
    Button pwr_button_;
    i2c_master_bus_handle_t i2c_bus_;
    PowerManager* power_manager_ = nullptr;
    MemomateBaseLink base_link_;
    MemomateControlLink control_link_;
    bool power_off_pending_ = false;

    void InitializePowerManager() {
        power_manager_ = new PowerManager(BATTERY_CHARGING_PIN, BATTERY_ADC_PIN, BATTERY_EN_PIN);
        power_manager_->PowerON();
    }

    // NOTE: no PowerSaveTimer. The phone form factor is always-on standby —
    // it must never auto-sleep or auto-power-off, so that lifting the handset
    // is instantly usable. The old (-1, 60, 300) timer auto-powered-off after
    // 300 s idle on battery; that's intentionally gone. Battery runtime is
    // handled by plugging in USB (a charge port is reserved). Manual power-off
    // stays available via PWR long-press. See SetPowerSaveMode below for why
    // the WiFi modem is also kept awake.

    void InitializeI2c() {
        i2c_master_bus_config_t i2c_bus_cfg = {
            .i2c_port = (i2c_port_t)I2C_NUM_0,
            .sda_io_num = AUDIO_CODEC_I2C_SDA_PIN,
            .scl_io_num = AUDIO_CODEC_I2C_SCL_PIN,
            .clk_source = I2C_CLK_SRC_DEFAULT,
            .glitch_ignore_cnt = 7,
            .intr_priority = 0,
            .trans_queue_depth = 0,
            .flags = {
                .enable_internal_pullup = 1,
            },
        };
        ESP_ERROR_CHECK(i2c_new_master_bus(&i2c_bus_cfg, &i2c_bus_));
    }

    void InitializeButtons() {
        // BOOT = talk key. While still starting and unprovisioned it doubles
        // as the WiFi-config escape hatch (same as the other Hao Lab boards).
        boot_button_.OnClick([this]() {
            auto& app = Application::GetInstance();
            if (app.GetDeviceState() == kDeviceStateStarting && !WifiStation::GetInstance().IsConnected()) {
                ResetWifiConfiguration();
                return;
            }
            app.ToggleChatState();
        });

        // PWR long-press → power off. Registered directly in the ctor (not
        // deferred to the first press-up) so it also works on a USB-C cold
        // boot where the user never touched PWR; the boot guard rejects the
        // long-press generated by the very tap that cold-started the MCU.
        pwr_button_.OnLongPress([this]() {
            if (esp_timer_get_time() < kBootLongPressGuardUs) {
                ESP_LOGI(TAG, "PWR long-press within boot guard — ignored");
                return;
            }
            // While the button stays held the long-press event re-fires
            // about once per second — latch so we run the sequence once.
            if (power_off_pending_) {
                return;
            }
            power_off_pending_ = true;
            PowerOffSequence();
        });
    }

    void PowerOffSequence() {
        ESP_LOGI(TAG, "Power off requested");
        // LED dark = powered off — that IS the feedback (灯语 rule: lit
        // whenever powered). Give the strip a moment to refresh before the
        // rails drop.
        auto* led = static_cast<MemomateLed*>(GetLed());
        led->ShowPowerOff();
        vTaskDelay(pdMS_TO_TICKS(200));
        power_manager_->PowerOff();
        // Still running ⇒ USB keeps the rails up and the battery latch can't
        // cut us. Restore the state color (never-dark rule) and re-arm so a
        // later battery-powered long-press still works.
        vTaskDelay(pdMS_TO_TICKS(2000));
        led->OnStateChanged();
        power_off_pending_ = false;
        ESP_LOGI(TAG, "Still on USB power — PowerOff is a no-op, re-armed");
    }

public:
    CustomBoard() :
        boot_button_(BOOT_BUTTON_GPIO), pwr_button_(PWR_BUTTON_GPIO) {
        InitializePowerManager();
        InitializeI2c();
        InitializeButtons();
    }

    // Bring up WiFi the normal xiaozhi way, then — only if STA actually
    // connected (not in AP config mode) — start the ESP-NOW base link. The
    // ESP-NOW peer rides the STA channel, so it must init after association.
    // Does NOT touch xiaozhi's provisioning / WS / OTA paths.
    virtual void StartNetwork() override {
        WifiBoard::StartNetwork();
        if (WifiStation::GetInstance().IsConnected()) {
            if (!base_link_.Start()) {
                ESP_LOGW(TAG, "base link failed to start (ESP-NOW unavailable)");
            }
            // Persistent control connection (proactive notifications / ring).
            // It rings the base over ESP-NOW via the base link. The task waits
            // for OTA to provision websocket.control, so starting here (before
            // the OTA poll) is fine. Does not touch the conversation WS / OTA.
            control_link_.SetRingSender(
                [this](bool start) { return base_link_.SendRing(start); });
            if (!control_link_.Start()) {
                ESP_LOGW(TAG, "control link failed to start");
            }
        } else {
            ESP_LOGI(TAG, "STA not connected (config mode?) — links deferred");
        }
    }

    virtual AudioCodec* GetAudioCodec() override {
        static Es8311AudioCodec audio_codec(
            i2c_bus_,
            I2C_NUM_0,
            AUDIO_INPUT_SAMPLE_RATE,
            AUDIO_OUTPUT_SAMPLE_RATE,
            AUDIO_I2S_GPIO_MCLK,
            AUDIO_I2S_GPIO_BCLK,
            AUDIO_I2S_GPIO_WS,
            AUDIO_I2S_GPIO_DOUT,
            AUDIO_I2S_GPIO_DIN,
            AUDIO_CODEC_PA_PIN,
            AUDIO_CODEC_ES8311_ADDR,
            true,
            false,
            AUDIO_CODEC_PA_VOLTAGE
        );
        return &audio_codec;
    }

    virtual Led* GetLed() override {
        static MemomateLed led(BUILTIN_LED_GPIO);
        return &led;
    }

    virtual bool GetBatteryLevel(int &level, bool& charging, bool& discharging) override {
        // Still report battery for the low-battery voice alert; no power-save
        // timer to toggle anymore (always-on standby).
        charging = power_manager_->IsCharging();
        discharging = power_manager_->IsDischarging();
        level = power_manager_->GetBatteryLevel();
        return true;
    }

    virtual void SetPowerSaveMode(bool /*enabled*/) override {
        // Phone form factor: always-on standby. Never let the WiFi modem enter
        // power-save sleep — the base's ESP-NOW frames (OFF_HOOK / 3s heartbeat)
        // must always be heard so "lift the handset = instantly talking". We
        // ignore the requested value and keep the modem awake. Higher idle
        // power is accepted (USB top-up via the reserved charge port).
        WifiBoard::SetPowerSaveMode(false);
    }
};

DECLARE_BOARD(CustomBoard);
